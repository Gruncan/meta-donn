## conf/layer.conf
```bitbake
# We have a conf and classes directory, add to BBPATH
BBPATH .= ":${LAYERDIR}"

# We have recipes-* directories, add to BBFILES
BBFILES += "${LAYERDIR}/recipes-*/*/*.bb \
            ${LAYERDIR}/recipes-*/*/*.bbappend"

BBFILE_COLLECTIONS += "meta-juntion"
BBFILE_PATTERN_meta-juntion = "^${LAYERDIR}/"
BBFILE_PRIORITY_meta-juntion = "6"

LAYERDEPENDS_meta-juntion = "core"
LAYERSERIES_COMPAT_meta-juntion = "kirkstone"
```
